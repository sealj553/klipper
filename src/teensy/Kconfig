## src/teensy/Kconfig
```kconfig
# Kconfig settings for teensy processors

if MACH_TEENSY

config TEENSY_SELECT
    bool
    default y
    select HAVE_GPIO
    #select HAVE_GPIO_ADC
    #select HAVE_GPIO_I2C
    #select HAVE_GPIO_SPI
    #select HAVE_GPIO_BITBANGING
    #select HAVE_CHIPID

config BOARD_DIRECTORY
    string
    default "teensy40"

choice
    prompt "Processor model"
    config MACH_TEENSY40
        bool "Teensy 4.0 (600 Mhz)"
endchoice

config MCU
    string
    default "teensy40" if MACH_TEENSY40

#config CLOCK_FREQ
#    int
#    default 600000000 if MACH_TEENSY40
#
#config FLASH_SIZE
#    hex
#    default 0x80000
#
#config RAM_START
#    hex
#    default 0x10000000
#
#config RAM_SIZE
#    hex
#    default 0x7fe0 # (0x8000 - 32) - top 32 bytes used by IAP functions
#
#config STACK_SIZE
#    int
#    default 512

#config SMOOTHIEWARE_BOOTLOADER
#    bool "Target board uses Smoothieware bootloader"
#    default y

#config FLASH_START
#    hex
#    #default 0x4000 if SMOOTHIEWARE_BOOTLOADER
#    default 0x0000

#config USBSERIAL
#    bool "Use USB for communication (instead of serial)"
#    default y
config SERIAL
    #depends on !USBSERIAL
    bool
    default y

endif
```
